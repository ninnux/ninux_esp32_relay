## components/ninux_esp32_mqtt/Kconfig
```kconfig
menu "Ninux MQTT Configuration"

    config BROKER_URL
        string "MQTT broker url"
        default "mqtt://lora.ninux.org"
        help
            MQTT broker URL address
  
endmenu
```

## main/Kconfig
```kconfig
menu "Ninux Relay MQTT topic"

    config MQTT_TOPIC_PREFIX 
        string "MQTT Topic prefix"
        default "comando/nodename/"
        help
            MQTT topic prefix 
    config MQTT_TOPIC_FEEDBACK_PREFIX 
        string "MQTT Topic feedback prefix"
        default "comando/feedback/nodename/"
        help
            MQTT topic feedback prefix 
  
endmenu
```
